## conf/layer.conf
```bitbake
# We have a conf and classes directory, add to BBPATH
BBPATH .= ":${LAYERDIR}"

# We have a recipes-* directories, add to BBFILES
BBFILES += "${LAYERDIR}/recipes-*/*/*.bb \
	${LAYERDIR}/recipes-*/*/*.bbappend"

BBFILE_COLLECTIONS += "up-board"
BBFILE_PATTERN_up-board = "^${LAYERDIR}/"
BBFILE_PRIORITY_up-board = "6"

LAYERDEPENDS_up-board = "intel"

BBMASK += "meta-virtualization/recipes-extended/iasl/iasl_20160527.bb"

LAYERSERIES_COMPAT_up-board = "warrior"
```
